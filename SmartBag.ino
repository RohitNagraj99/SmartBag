char Book[11]="";
int result=0;

/////////////////////////////////////////////////////////////   SETUP FUNCTION   //////////////////////////////////////////////////////////////////////////////////////////////////////
void setup()
{
   Serial.begin(9600);
}

////////////////////////////////////////////////////////////    LOOP FUNCTION    ////////////////////////////////////////////////////////////////////////////////
void loop()
{
  result=0;
  readBook();
  if (result == 1)
  {
    correct();
  }
  else if (result == -1)
  {
    wrong();
  }
  
}

////////////////////////////////////////////////////////////    READBOOK FUNCTION   ///////////////////////////////////////////////////////////////////////////////////////////////////////
void readBook()
{
  int count=0;
  strcpy(Book,"");

  if(Serial.available())
  {
    count=0;

    while(Serial.available() && count<11)
    {
      Book[count] = Serial.read();
      count++;
      delay(5);
    }

    if (count==11)
    {
      count=0;
      bookCheck();
    }
  }
//    if(strcmp(Book,"")!=0)
//  {
//    for(int x=0;x<10;x++)
//    {
//      Serial.write(Book[x]);
//    }
//  }
}

/////////////////////////////////////////////////////////////    BOOKCHECK FUNCTION   //////////////////////////////////////////////////////////////////////////////////////////////////////
void bookCheck()
{
  char Book1[] ="$0003935043";
  int flag=1;
  int count=0;

  while(count<11 && flag!=-1)
  {
    if(Book[count]==Book1[count])
    {
      flag=1;
    }
    else
    {
      flag=-1;
    }
    count++;
  }
  result=flag;
}
////////////////////////////////////////////////////////////   CORRECT FUNCTION    /////////////////////////////////////////////////////////////////////////////////////////

void correct()
{
  Serial.println("Correct Book");

}

///////////////////////////////////////////////////////////// WRONG FUNCTION   ///////////////////////////////////////////////////////////////////////////////////
void wrong()
{
  Serial.println("Wrong Book");
}

